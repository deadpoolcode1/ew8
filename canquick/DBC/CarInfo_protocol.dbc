VERSION ""

NS_ :

BS_:

BU_: car_signal
VAL_TABLE_ bool 1 "on" 0 "off" ;

BO_ 3221225472 VECTOR__INDEPENDENT_SIG_MSG: 0 Vector__XXX
 SG_ LowBeam : 0|1@1+ (1,0) [0|1] "" Vector__XXX

BO_ 1888 signal_car: 8 Vector__XXX
 SG_ Reverse_Gear : 4|1@1+ (1,0) [0|1] "" Vector__XXX
 SG_ Reverse_Gear_availabled : 12|1@1+ (1,0) [0|1] "" Vector__XXX
 SG_ Gyro_Data_LSB : 48|8@1+ (1,0) [0|255] "" Vector__XXX
 SG_ Gyro_Data_MSB : 40|8@1+ (1,0) [0|255] "" Vector__XXX
 SG_ G_Data_LSB : 32|8@1+ (1,0) [0|255] "" Vector__XXX
 SG_ G_Data_MSB : 24|8@1+ (1,0) [0|255] "" Vector__XXX
 SG_ Speed_availabled : 15|1@1+ (1,0) [0|1] "" Vector__XXX
 SG_ Right_blink_availabled : 10|1@1+ (1,0) [0|1] "" Vector__XXX
 SG_ Left_blink_availabled : 9|1@1+ (1,0) [0|1] "" Vector__XXX
 SG_ Brakes_availabled : 8|1@1+ (1,0) [0|1] "" Vector__XXX
 SG_ Wipers_availabled : 11|1@1+ (1,0) [0|1] "" Vector__XXX
 SG_ HighBeam_availabled : 13|1@1+ (1,0) [0|1] "" Vector__XXX
 SG_ G_availabled : 6|1@1+ (1,0) [0|1] "" Vector__XXX
 SG_ Brakes : 0|1@1+ (1,0) [0|1] "" Vector__XXX
 SG_ Left_blink : 1|1@1+ (1,0) [0|1] "" Vector__XXX
 SG_ Right_blink : 2|1@1+ (1,0) [0|1] "" Vector__XXX
 SG_ Wipers : 3|1@1+ (1,0) [0|1] "" Vector__XXX
 SG_ HighBeam : 5|1@1+ (1,0) [0|1] "" Vector__XXX
 SG_ Gyro_availabled : 14|1@1+ (1,0) [0|1] "" Vector__XXX
 SG_ reserved : 7|1@1+ (1,0) [0|1] "" Vector__XXX
 SG_ Speed : 16|8@1+ (1,0) [0|255] "km/h" Vector__XXX
 SG_ shieldPlusSettings : 56|8@1+ (1,0) [0|255] "" Vector__XXX

CM_ BO_ 3221225472 "This is a message for not used signals, created by Vector CANdb++ DBC OLE DB Provider.";
CM_ SG_ 3221225472 LowBeam "When signal is on the bit is on";
CM_ SG_ 1888 Reverse_Gear "When signal is on the bit is on";
CM_ SG_ 1888 Reverse_Gear_availabled "When signal availabled the bit is on";
CM_ SG_ 1888 Speed_availabled "When signal availabled the bit is on";
CM_ SG_ 1888 Right_blink_availabled "When signal availabled the bit is on";
CM_ SG_ 1888 Left_blink_availabled "When signal availabled the bit is on";
CM_ SG_ 1888 Brakes_availabled "When signal availabled the bit is on";
CM_ SG_ 1888 Wipers_availabled "When signal availabled the bit is on";
CM_ SG_ 1888 HighBeam_availabled "When signal availabled the bit is on";
CM_ SG_ 1888 G_availabled "When signal availabled the bit is on";
CM_ SG_ 1888 Brakes "When signal is on the bit is on";
CM_ SG_ 1888 Left_blink "When signal is on the bit is on";
CM_ SG_ 1888 Right_blink "When signal is on the bit is on";
CM_ SG_ 1888 Wipers "When signal is on the bit is on";
CM_ SG_ 1888 HighBeam "When signal is on the bit is on";
CM_ SG_ 1888 Gyro_availabled "When signal availabled the bit is on";
