## EW8yocto/meta-mobileye-master/conf/distro/poky-mobileye-dev.conf
```bitbake
require conf/distro/poky-atmel.conf

DISTRO = "poky-mobileye"

KERNEL_MODULE_AUTOLOAD += "atmel_usba_udc"
KERNEL_MODULE_AUTOLOAD += "g_ether"
KERNEL_MODULE_PROBECONF += "g_ether"
module_conf_g_ether = "options g_ether host_addr=c2:c0:74:d1:cA:81 dev_addr=32:4a:c3:9f:1e:38"
```

## EW8yocto/meta-mobileye-master/conf/machine/sama5d2-baby.conf
```bitbake
#@TYPE: Machine
#@Name: ATMEL SAMA5D2 Xplained eMMC
#@DESCRIPTION: Machine configuration for Atmel's evaluation board, boot from eMMC

require conf/machine/include/sama5d2.inc
#require conf/machine/sama5d2-xplained.conf

MACHINE_FEATURES = "apm ext4 usbgadget screen"
MACHINE_FEATURES_BACKFILL_CONSIDERED += "rtc"

KERNEL_DEVICETREE = " \
		at91-sama5d2_baby.dtb \
		at91-sama5d2_baby_pcb353.dtb \
		at91-sama5d2_baby_pcb000928.dtb \
		at91-sama5d2_baby_synth.dtb \
		"

#WARNING: loaded separately before the application, after the panel
KERNEL_MODULE_PROBECONF += "atmel-hlcdc-dc"
module_conf_atmel-hlcdc-dc = "blacklist atmel-hlcdc-dc"



IMAGE_FSTYPES = "wic.xz wic.bmap"

#do_image_wic[depends] += "u-boot-at91:do_deploy linux-at91:do_deploy"
WKS_FILE = "baby_emmc_image.wks.in"
#WKS_FILE = "sdimage-bootpart.wks"
#IMAGE_BOOT_FILES = "BOOT.BIN u-boot.bin sama5d2_xplained.itb"
IMAGE_BOOT_FILES = "${KERNEL_IMAGETYPE} ${KERNEL_DEVICETREE}"

UBOOT_MACHINE ?= "sama5d2_baby_defconfig"
UBOOT_ENTRYPOINT = "0x20008000"
UBOOT_LOADADDRESS = "0x20008000"

#AT91BOOTSTRAP_MACHINE ?= "sama5d2_xplained"
#AT91BOOTSTRAP_CONFIG ?= "${AT91BOOTSTRAP_MACHINE}emmc_uboot"


# Replace the bootstrap provider:

# a) Same name package case:
#PREFERRED_PROVIDER_at91bootstrap="at91bootstrap-mobileye"

# a) Special name package case:
EXTRA_IMAGEDEPENDS_remove = "at91bootstrap"
EXTRA_IMAGEDEPENDS += "at91bootstrap-mobileye"

AT91BOOTSTRAP_MACHINE ?= "sama5d2_baby"
AT91BOOTSTRAP_CONFIG ?= "${AT91BOOTSTRAP_MACHINE}emmc_linux_image_dt"
```
