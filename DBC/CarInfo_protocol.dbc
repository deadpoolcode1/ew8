VERSION ""

NS_ :

BS_:

BU_: car_signal
VAL_TABLE_ bool 1 "on" 0 "off" ;

BO_ 1888 signal_car: 8 Vector__XXX
 SG_ Shield_plus : 56|8@1+ (1,0) [0|0] "" Vector__XXX
 SG_ Speed_avaliable : 15|1@1+ (1,0) [0|1] "" Vector__XXX
 SG_ Right_blink_avaliable : 10|1@1+ (1,0) [0|1] "" Vector__XXX
 SG_ Left_blink_avaliable : 9|1@1+ (1,0) [0|1] "" Vector__XXX
 SG_ Brakes_avaliabled : 8|1@1+ (1,0) [0|1] "" Vector__XXX
 SG_ Wipers_availabled : 11|1@1+ (1,0) [0|1] "" Vector__XXX
 SG_ HighBeam_availabled : 13|1@1+ (1,0) [0|1] "" Vector__XXX
 SG_ LowBeam_availabled : 12|1@1+ (1,0) [0|1] "" Vector__XXX
 SG_ Brakes : 0|1@1+ (1,0) [0|1] "" Vector__XXX
 SG_ Left_blink : 1|1@1+ (1,0) [0|1] "" Vector__XXX
 SG_ Right_blink : 2|1@1+ (1,0) [0|1] "" Vector__XXX
 SG_ Wipers : 3|1@1+ (1,0) [0|1] "" Vector__XXX
 SG_ LowBeam : 4|1@1+ (1,0) [0|1] "" Vector__XXX
 SG_ HighBeam : 5|1@1+ (1,0) [0|1] "" Vector__XXX
 SG_ reserved1 : 14|1@1- (1,0) [-1|0] "" Vector__XXX
 SG_ reserved2 : 6|2@1- (1,0) [0|1] "" Vector__XXX
 SG_ speed : 16|8@1+ (1,0) [0|255] "km/h" Vector__XXX
 SG_ reserved : 24|32@1- (1,0) [-2147483648|2147483647] "" Vector__XXX

CM_ SG_ 1888 Wipers_availabled "When signal availabled the bit is on";
CM_ SG_ 1888 HighBeam_availabled "When signal availabled the bit is on";
CM_ SG_ 1888 LowBeam_availabled "When signal availabled the bit is on";
CM_ SG_ 1888 Brakes "When signal is on the bit is on";
CM_ SG_ 1888 Left_blink "When signal is on the bit is on";
CM_ SG_ 1888 Right_blink "When signal is on the bit is on";
CM_ SG_ 1888 LowBeam "when signal is on the bit is on";
CM_ SG_ 1888 HighBeam "When signal is on the bit is on";
VAL_ 1888 Wipers_availabled 1 "on" 0 "off" ;
VAL_ 1888 HighBeam_availabled 1 "on" 0 "off" ;
VAL_ 1888 LowBeam_availabled 1 "on" 0 "off" ;
VAL_ 1888 Brakes 1 "on" 0 "off" ;
VAL_ 1888 Left_blink 1 "on" 0 "off" ;
VAL_ 1888 Right_blink 1 "on" 0 "off" ;
VAL_ 1888 Wipers 1 "on" 0 "off" ;
VAL_ 1888 LowBeam 1 "on" 0 "off" ;
VAL_ 1888 HighBeam 1 "on" 0 "off" ;
